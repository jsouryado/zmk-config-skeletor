n/*
 * Copyright (c) 2020 Pete Johanson
 *
 * SPDX-License-Identifier: MIT
 */

#include "jsouryado.dtsi"

&kscan0 {
    diode-direction = "col2row";
    row-gpios = <&gpio0 24 (GPIO_ACTIVE_HIGH | GPIO_PULL_DOWN)>,
                <&gpio1 00 (GPIO_ACTIVE_HIGH | GPIO_PULL_DOWN)>,
                <&gpio0 11 (GPIO_ACTIVE_HIGH | GPIO_PULL_DOWN)>,
                <&gpio1 04 (GPIO_ACTIVE_HIGH | GPIO_PULL_DOWN)>;
                <&gpio1 06 (GPIO_ACTIVE_HIGH | GPIO_PULL_DOWN)>;

    col-gpios = <&gpio1 15 GPIO_ACTIVE_HIGH>,
                <&gpio1 13 GPIO_ACTIVE_HIGH>,
                <&gpio1 11 GPIO_ACTIVE_HIGH>,
                <&gpio0 10 GPIO_ACTIVE_HIGH>,
                <&gpio0 9 GPIO_ACTIVE_HIGH>;
};

/ {
    wired_split {
        compatible = "zmk,wired-split";
        device = <&uart0>;
    };
};

/* make sure the hardware UART exists */
&uart0 {
    status = "okay";
    current-speed = <1000000>;
    pinctrl-0 = <&uart0_default>;
};
