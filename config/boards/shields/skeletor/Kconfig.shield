## config/boards/shields/skeletor/Kconfig.shield
```kconfig
# Copyright (c) 2020 Pete Johanson
# SPDX-License-Identifier: MIT

config SHIELD_JSOURYADO_LEFT
    def_bool $(shields_list_contains,jsouryado_left)

config SHIELD_JSOURYADO_RIGHT
    def_bool $(shields_list_contains,jsouryado_right)

config SHIELD_JSOURYADO_DONGLE
    def_bool $(shields_list_contains,jsouryado_dongle) 
```
